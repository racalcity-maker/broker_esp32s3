## components/broker_config/Kconfig.projbuild
```kconfig
menu "Broker Configuration"

config BROKER_I2S_BCK_PIN
    int "I2S BCLK GPIO"
    default 4
    help
        GPIO used for the I2S bit clock (BCK) line that feeds the DAC/amplifier.
        Set to the pin wired to your audio codec.

config BROKER_I2S_WS_PIN
    int "I2S LRCK/WSEL GPIO"
    default 5
    help
        GPIO for the I2S word select / LRCLK line.

config BROKER_I2S_DATA_PIN
    int "I2S DATA GPIO"
    default 6
    help
        GPIO used for the I2S data output towards the DAC.

config BROKER_SD_MISO_PIN
    int "SD card MISO GPIO"
    default 13
    help
        GPIO connected to the SD card MISO line (SPI mode).

config BROKER_SD_MOSI_PIN
    int "SD card MOSI GPIO"
    default 11
    help
        GPIO connected to the SD card MOSI line (SPI mode).

config BROKER_SD_CLK_PIN
    int "SD card CLK GPIO"
    default 12
    help
        GPIO connected to the SD card CLK line (SPI mode).

config BROKER_SD_CS_PIN
    int "SD card CS GPIO"
    default 10
    help
        GPIO used for SD card chip select (SPI mode).

config BROKER_MQTT_MAX_CLIENTS
    int "Maximum simultaneous MQTT clients"
    default 16
    range 1 64
    help
        Number of concurrent MQTT sessions the embedded broker accepts.
        Higher values increase PSRAM usage.

config BROKER_WEB_AUTH_DEFAULT_USER
    string "Default Web UI username"
    default "admin"
    help
        Username used for initial login to the Web UI. Change it
        after flashing or via the Settings tab.

config BROKER_WEB_AUTH_DEFAULT_PASS
    string "Default Web UI password"
    default "admin"
    help
        Password used for initial login to the Web UI. After the
        device boots, change it from the Settings tab.

config BROKER_WEB_AUTH_RESET_GPIO
    int "Web auth reset GPIO"
    default -1
    help
        When set to a valid GPIO number, holding this pin LOW for
        ~10 seconds resets the Web UI credentials back to the defaults.
        Set to -1 to disable the hardware reset feature.

endmenu
```

## tests/device_manager/sdkconfig.defaults
```kconfig
CONFIG_IDF_TARGET="esp32s3"
CONFIG_ESPTOOLPY_FLASHMODE_DIO=y
CONFIG_ESPTOOLPY_FLASHFREQ_80M=y
CONFIG_ESPTOOLPY_FLASHSIZE_16MB=y
CONFIG_PARTITION_TABLE_CUSTOM=y
CONFIG_PARTITION_TABLE_CUSTOM_FILENAME="partitions.csv"
CONFIG_ESP_DEFAULT_CPU_FREQ_MHZ_240=y
CONFIG_ESP32S3_DEFAULT_CPU_FREQ_240=y
CONFIG_SPIRAM=y
CONFIG_SPIRAM_MODE_OCT=y
CONFIG_SPIRAM_TYPE_AUTO=y
CONFIG_SPIRAM_SPEED_80M=y
CONFIG_SPIRAM_BOOT_INIT=y
CONFIG_SPIRAM_USE_MALLOC=y
CONFIG_SPIRAM_ALLOW_STACK_EXTERNAL_MEMORY=y
CONFIG_SPIRAM_ALLOW_BSS_SEG_EXTERNAL_MEMORY=y
CONFIG_DEFAULT_PSRAM_CLK_IO=30
CONFIG_DEFAULT_PSRAM_CS_IO=26
# CONFIG_ESP_TASK_WDT_EN is not set
# CONFIG_ESP_TASK_WDT_INIT is not set
# CONFIG_ESP_TASK_WDT_CHECK_IDLE_TASK_CPU0 is not set
# CONFIG_ESP_TASK_WDT_CHECK_IDLE_TASK_CPU1 is not set
# CONFIG_TASK_WDT is not set
# CONFIG_TASK_WDT_CHECK_IDLE_TASK_CPU0 is not set
# CONFIG_TASK_WDT_CHECK_IDLE_TASK_CPU1 is not set
CONFIG_ESP_MAIN_TASK_STACK_SIZE=8192
CONFIG_MAIN_TASK_STACK_SIZE=8192
```

## tests/mqtt_core/sdkconfig.defaults
```kconfig
CONFIG_SPIRAM=y
CONFIG_SPIRAM_MODE_OCT=y
CONFIG_SPIRAM_TYPE_AUTO=y
CONFIG_SPIRAM_SPEED_80M=y
CONFIG_SPIRAM_BOOT_INIT=y
CONFIG_SPIRAM_USE_MALLOC=y
CONFIG_SPIRAM_ALLOW_STACK_EXTERNAL_MEMORY=y
CONFIG_SPIRAM_ALLOW_BSS_SEG_EXTERNAL_MEMORY=y
CONFIG_DEFAULT_PSRAM_CLK_IO=30
CONFIG_DEFAULT_PSRAM_CS_IO=26
```
